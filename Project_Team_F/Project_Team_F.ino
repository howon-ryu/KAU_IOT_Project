
//프로젝트 진행하기 


#include <AWS_IOT.h>
#include <WiFi.h>
#include <Arduino_JSON.h> // refer JSONObject example for more information!!!
#include <Wire.h> //I2c
#include <Adafruit_Sensor.h>
#include <Adafruit_BME280.h>
#define SEALEVELPRESSURE_HPA (1013.25)
#define Moisture_PIN 36  // Moisture sensor (data) pin connected to ESP32(IO/36)
#define ARR_SIZE 200
#define DUST_VOC 0.8
#define UNTILL_MILLS 1000

/////Add oled lib///////////////////////////////////////////////////

#include <SPI.h>
#include <Wire.h>
#include <Adafruit_GFX.h>
#include <Adafruit_SH110X.h>

#define OLED_MOSI 13 // 9
#define OLED_CLK 14 //10
#define OLED_DC 26 //11
#define OLED_CS 12 //12
#define OLED_RESET 27 //13

// Create the OLED display
Adafruit_SH1106G display = Adafruit_SH1106G(128, 64,OLED_MOSI, OLED_CLK, OLED_DC, OLED_RESET, OLED_CS);


#define NUMFLAKES 10
#define XPOS 0
#define YPOS 1
#define DELTAY 2


#define LOGO16_GLCD_HEIGHT 16
#define LOGO16_GLCD_WIDTH  16

//추운 이모티콘 

const unsigned char coldImage[] PROGMEM = {
  B00000000,B00000000,B00000000,B00000000,B00000000,B00000000,B00000111,B11111111,B11111111,B11111100,B00000000,B00000000,B00000000,B00000000,B00000000,B00000000,
  B00000000,B00000000,B00000000,B00000000,B00000000,B00000000,B01111111,B11111111,B11111111,B11111111,B11110000,B00000000,B00000000,B00000000,B00000000,B00000000,
  B00000000,B00000000,B00000000,B00000000,B00000000,B00000001,B11111000,B00000000,B00000000,B00000001,B11111110,B00000000,B00000000,B00000000,B00000000,B00000000,
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  B00000000,B00000000,B00000000,B00000000,B00011111,B11111111,B11111111,B11111111,B11111111,B11111111,B11111111,B11111000,B00000000,B00000000,B00000000,B00000000
};


////////////////////////////////////////////////////////////////////


//더운 이모티콘 

const unsigned char Hot_image[] PROGMEM = {
  B00000000,B00000000,B00000000,B01111111,B11110000,B00000000,B00000000,B00000000,B00000000,B00000000,B00000000,B00000011,B11000000,B00000000,B00000000,B00000000,
  B00000000,B00000000,B00000111,B11111111,B11111111,B00000000,B00000000,B00000000,B00000000,B00000000,B00000000,B00000011,B11100000,B00000000,B00000000,B00000000,
  B00000000,B00000000,B00111111,B11111111,B11111111,B11100000,B00000000,B00000000,B00000000,B00000000,B00000000,B00000011,B11100000,B00000000,B00000000,B00000000,
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  B00000000,B00000000,B00000001,B11111111,B11111100,B00000000,B00000000,B00000000,B00000000,B00000000,B00000000,B00000000,B00000000,B00000000,B00000000,B00000000
};

//건조한 이모티콘 

const unsigned char Dry_image[] PROGMEM = {
  B00000000,B00000000,B00000000,B00000000,B00000000,B00000000,B00111111,B11111111,B00000000,B00000000,B00000000,B00000000,B00000000,B00000000,B00000000,B00000000,
  B00000000,B00000000,B00000000,B00000000,B00000000,B00000111,B11000000,B00000000,B11111000,B00000000,B00000000,B00000000,B00000000,B00000000,B00000000,B00000000,
  B00000000,B00000000,B00000000,B00000000,B00000000,B00111000,B00000011,B00000001,B00000111,B00000000,B00000000,B00000000,B00000000,B00000000,B00000000,B00000000,
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  B00000000,B00000000,B00000000,B00000000,B00011111,B11111111,B11111111,B11111111,B11111111,B11111111,B11111111,B11111000,B00000000,B00000000,B00000000,B00000000
};

//습한 이모티콘 

const unsigned char ToohumidImage[] PROGMEM = {
  B00000000,B00000000,B00000000,B00000000,B00000000,B00000111,B11111111,B11111000,B00000000,B00000000,B00000000,B00000000,B00000000,B00000000,B00000000,B00000000,
  B00000000,B00000000,B00000000,B00000000,B00000000,B11111111,B11111111,B11111111,B11100000,B00000000,B00000000,B00000000,B00000000,B00000000,B00000000,B00000000,
  B00000000,B00000000,B00000000,B00000000,B00001111,B11111111,B11111111,B11111111,B11111100,B00000000,B00000000,B00000000,B00000000,B00000000,B00000000,B00000000,
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  B00000000,B00000000,B00000000,B00000000,B00000000,B00011111,B11000000,B00000000,B00000000,B00000011,B11111000,B00000000,B00000000,B00000000,B00000000,B00000000
};

//물부족 이모티콘 

const unsigned char WaterPumpImage[] PROGMEM = {
  B00000000,B00000000,B00000000,B00000000,B00000000,B00000000,B00000000,B00000011,B11000000,B00000000,B00000000,B00000000,B00000000,B00000000,B00000000,B00000000,
  B00000000,B00000000,B00000000,B00000000,B00000000,B00000000,B00000000,B00001111,B11110000,B00000000,B00000000,B00000000,B00000000,B00000000,B00000000,B00000000,
  B00000000,B00000000,B00000000,B00000000,B00000000,B00000000,B00000000,B00001111,B11110000,B00000000,B00000000,B00000000,B00000000,B00000000,B00000000,B00000000,
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  B00000000,B00000000,B00000000,B00000000,B00000000,B00000000,B00000001,B11111111,B11111111,B10000000,B00000000,B00000000,B00000000,B00000000,B00000000,B00000000
};


//기본 이모티콘 

const unsigned char Defalut_Image[] PROGMEM = {
  B00000000,B00000000,B00000000,B00000000,B00000000,B00000000,B00000000,B00000000,B00000000,B00000000,B00000000,B00000000,B00000000,B00000000,B00000000,B00000000,
  B00000000,B00000000,B00000000,B00000000,B00000000,B00000000,B00000000,B00000000,B00000000,B00000000,B00000000,B00000000,B00000000,B00000000,B00000000,B00000000,
  B00000000,B00000000,B00000000,B00000000,B00000000,B00000001,B11111111,B10000000,B00000000,B00000000,B00000000,B00000000,B00000011,B11111111,B00000000,B00000000,
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  B00000000,B00000000,B00000000,B00000000,B00000000,B00000000,B00000000,B00000000,B00000000,B00000000,B00000000,B00000000,B00000000,B00000000,B00000000,B00000000
};


//*-----------------------------------------------------------------------*


////set the 3 rgb led pin///////
int red_pin = 5;
int blue_pin = 18;
int green_pin = 19;

////////////////////////////////



int delayTime;

AWS_IOT testButton;
AWS_IOT testButton2;
const char* ssid = "성주의 iPhone se 2020";
const char* password = "12345678";
char HOST_ADDRESS[]="a2meoi9yj8lawc-ats.iot.ap-northeast-2.amazonaws.com";
char CLIENT_ID[]= "ChoiESP32";

char sTOPIC_NAME[]= "$aws/things/BME280/shadow/update"; // subscribe topic name
//char realTOPIC[] = "bme280/realtime";

char pTOPIC_NAME[]= "$aws/things/BME280/shadow/update"; // publish topic name

//char 

int status = WL_IDLE_STATUS;
int msgCount=0,msgReceived = 0;
char payload[512];
char rcvdPayload[512];
char payload_pump[512];
char rcvPayload_pump[512];


//////

/*int msgCount2=0,msgReceived2 = 0;
char payload2[512];
char rcvdPayload2[512];
char payload_pump2[512];
char rcvPayload_pump2[512];*/
///////////////


unsigned long preMil = 0; 
const long intMil = 60000; //1hour 3600000 //60000
const long pumpMil = 30000; //30min 1800000
unsigned long preMillisCheck = 0;

// Soil Moister sensor constants ----------------------------
const int AirValue = 4095;  // row value (high)
const int WaterValue = 1540; // row value (low)
int intervals = (AirValue - WaterValue)/3;
int soilMoistureValue = 0;
int soilArr[ARR_SIZE];



int pump_AA = 16;
int pump_AB = 17;

String led;
String led2;
//*-------------------------------------------------------*

///////Dust set//////////////////////////////////////////////


unsigned long prevMeasure;
unsigned long measureInterval = 20; 
int dustVocPin =39;
int iredPin = 32; 

float AvgDustResult = 0;

long sumVocValue = 0;
unsigned long avgVocValue = 0;


/////////////////////////////////////////////////////////////


//*--------------------------------------------------------------*



////////Bme280 set //////////////////////////////////////////////////



Adafruit_BME280 bme; // I2C
unsigned long sumValue_temp = 0;
unsigned long sumValue_humid = 0;
unsigned long avgValue_temp = 0;
unsigned long avgValue_humid = 0;


int bmeTemp[ARR_SIZE];
int bmeHumid[ARR_SIZE];

float bme_tempVal=0;
float bme_humidVal=0;
int Bme_Power = 4;
int bmeID=0;

int flag1,flag2,flag3,flag4,flag5;
int liveState;
  


//BME 280 print value function
void printValues() 
{
  Serial.print("Temperature = ");
  Serial.print(bme.readTemperature());
  Serial.println(" *C");
  Serial.print("Pressure = ");
  Serial.print(bme.readPressure() / 100.0F);
  Serial.println(" hPa");
  Serial.print("Approx. Altitude = ");
  Serial.print(bme.readAltitude(SEALEVELPRESSURE_HPA));
  Serial.println(" m");
  Serial.print("Humidity = ");
  Serial.print(bme.readHumidity());
  Serial.println(" %");
  Serial.println();
}
float get_bme_temp_Avg()
{

  sumValue_temp = 0;
  avgValue_temp =0;
  int bme_idx_t = 0;
  bmeTemp[ARR_SIZE] = {0,};
  //smapling the temp data
  while(1)
  {
    bmeTemp[bme_idx_t] = bme.readTemperature();
    delayMicroseconds(50);
   
    bme_idx_t = (bme_idx_t+1)%ARR_SIZE;
    delayMicroseconds(30);
    
    if(bme_idx_t==199)
    {
      
      //get sum result 
      for(int i=0;i<ARR_SIZE;i++)
      {
        sumValue_temp = sumValue_temp + bmeTemp[i];
      }
      
      avgValue_temp = sumValue_temp/ARR_SIZE;
        
      return (float)avgValue_temp;
      
    }
  

  }
}


float get_bme_humid_Avg()
{
  sumValue_humid  = 0;
  avgValue_humid=0;
  bmeHumid[ARR_SIZE] = {0,};
  int bme_idx_h=0;
  while(1)
  {
    //sampling the humid data
    
    bmeHumid[bme_idx_h] = bme.readHumidity();
    delayMicroseconds(50);
   
    bme_idx_h = (bme_idx_h+1)%ARR_SIZE;
    delayMicroseconds(30);
    
    if(bme_idx_h==199)
    {
        //get sum result 
      for(int i=0;i<ARR_SIZE;i++)
      {
        sumValue_humid = sumValue_humid + bmeHumid[i];  
      }
      avgValue_humid = sumValue_humid / ARR_SIZE;
      return (float)avgValue_humid;
  
    }
  }

}
//////////////////////////////////////////////////////////////////////////////
//Soil Moisture sensor function


int readSoilMoister()
{

  int avg_soil=0;
  int processed_value = 0;
  int soilidx = 0;
  soilArr[ARR_SIZE]={0,};
  while(1)
  {
    soilMoistureValue = analogRead(Moisture_PIN); //put Sensor insert into soil
    soilArr[soilidx] = 100 - (scaling(soilMoistureValue, WaterValue, AirValue, 0, 100));
     
    delayMicroseconds(30);
    soilidx = (soilidx+1)%ARR_SIZE;
    delayMicroseconds(30);
    
    if(soilidx==199)
    {
      for(int i=0;i<ARR_SIZE;i++)
      {
        processed_value = processed_value + soilArr[i];
      }
    
      avg_soil = processed_value/ARR_SIZE;
      
      return (avg_soil); //SCALINE soil moisture value in range of 0% - 100%
    }
  
  }
}
//--------------------------------------------------------------------------------------------

// scaling function to convert from any range to any range
int scaling(int value, int rowMin, int rowMax, int newRange0, int newRange100 ) 
{
    int x = (((value - rowMin) * (newRange100 - newRange0)) / (rowMax - rowMin)) + newRange0;
    if (x < 0)
    { 
      return 0;
    }
    else if(x > 100)
    { 
      return 100; 
    }
    else
    { 
      return x; 
    }


}
//*-----------------------------------------------------------------------*

// get Avg dust value function 

float getAvgDustVal()
{

  //initialize value 
  sumVocValue =0;
  avgVocValue=0;
  int count=0;
  float smoothDensity=0;
  prevMeasure=millis();
  while(1)
  {
    float voMeasured = 0;  
    float calcVoltage = 0;  
    float dustDensity = 0;  
    
    //iled 켜기 
    digitalWrite(iredPin,LOW);
      
    delayMicroseconds(280);     //sampling time 
    voMeasured = analogRead(dustVocPin);
    
    //Serial.print("analog ");
    //Serial.println(voMeasured);
    delayMicroseconds(40);
    digitalWrite(iredPin,HIGH);
    delayMicroseconds(9680);
    
    // 0 - 5V mapped to 0 - 1023 integer values  
    calcVoltage = voMeasured * (5.0 / 1024.0);  
    calcVoltage = (calcVoltage - DUST_VOC)/0.005;
    
    delayMicroseconds(40);
    sumVocValue = sumVocValue+calcVoltage;
    //Serial.print("sumval is ");
    //Serial.println(sumVocValue);
    //Serial.print("calcVoltage is");
    //Serial.println(calcVoltage);

    count=count+1;
    

    if(millis()-prevMeasure >= 1100)
    {
      prevMeasure = millis();
      avgVocValue  = sumVocValue / count ;
      //Serial.print("count is ");
      //Serial.println(count);
      //Serial.print("avgVocValue is ");
      //Serial.println(avgVocValue);
      return (float)avgVocValue;
      
    }
    
    
    
    
  }
}

//*-------------------------------------------------------------------------*

void mySubCallBackHandler (char *topicName, int payloadLen, char *payLoad)
{
  strncpy(rcvdPayload,payLoad,payloadLen);
  rcvdPayload[payloadLen] = 0;
  msgReceived = 1;
}

/////maybe you need mysubcallbackHandler2////////////////
//if need the callback function implement the new callbackHandler function!!
/*void mySubCallBackHandler2 (char *topicName, int payloadLen2, char *payLoad2)
{
  strncpy(rcvdPayload2,payLoad2,payloadLen2);
  rcvdPayload2[payloadLen2] = 0;
  msgReceived2 = 1;
}*/
/////////////////////////////////////////////////////////


//*-------------------------------------------------------------------------*
//check untill soil value change function 

int cf=0;

void check_soil_funct(int soil_val)
{
  //for debug 
  Serial.println("Im in the check soil function!!"); 

  cf=1;
  //OLED 물 이모티콘 보내기 ////////////////
  // Clear the buffer.
  display.clearDisplay();
  
  // Draw bitmap on the screen
  display.drawBitmap(0,0,WaterPumpImage, 128, 64, 1);
  display.display();
  ///////////////////////////////////////

  //led Red 활성화 하기 ////////////////////////
  digitalWrite(red_pin,HIGH);
  
  ////////////////////////////////////////////

  //30분 기준으로 몇번 지났는지 세는 변수 
  int count = 0; 
  int temp_val=0;

  
  
  

  publishData(count);

  
  
  while(1)
  {
    
    int temp_val = readSoilMoister();
    Serial.print("temp val is ");
    Serial.println(temp_val);
    if(temp_val > soil_val && temp_val > 20)
    {
      digitalWrite(red_pin,LOW);
      display.clearDisplay();
      return ;
    }
    
    check_live_curret(msgReceived);
    led="";
    led2="";
    
      //변화가 없을때 
    //30min 지났을때 발행 하기 
    if((millis()-preMillisCheck)>=pumpMil)
    {
      Serial.println("After 30min ");
      count = count+1;
      preMillisCheck=millis();
      publishData(count);
        
    }
  }   
  
  
}



//*-------------------------------------------------------------------------*
void offFunct()
{
  digitalWrite(red_pin,LOW);
  digitalWrite(blue_pin,LOW);
  digitalWrite(green_pin,LOW);
  
}

void publishData(int countval)
{


  Serial.println("for debuger publish function start  ");
  
  
  int soil_moisture = readSoilMoister();    //avg soil moisture 


  delayMicroseconds(40);
  bme_tempVal = get_bme_temp_Avg();
  delayMicroseconds(40);
  bme_humidVal = get_bme_humid_Avg();
  delayMicroseconds(40);

  
  //습도와 온도 적절한지 확인한다 
  flag1=0;
  flag2 =0;
  flag3=0;
  flag4=0;

  //flag5 설정 
  Serial.print("livedata pub function ");
  Serial.println(led);
  Serial.println(flag5);

  /////
/*
  화면은 마지막껄로 바꾸어도 flag는 보낸다 앱에서 처리 
  

*/
  
  //건조하다의 조건을 40 밑으로 설정 했는데 **조정 될수있다** 
  if(bme_humidVal < 43) //test 43  실제는 40
  {
    offFunct();
    digitalWrite(blue_pin,HIGH);
    
    flag1=1;

    if(!cf)
    {
      //Dry_image
      display.clearDisplay();
    
      // Draw bitmap on the screen
      display.drawBitmap(0, 0, Dry_image, 128, 64, 1);
      display.display();
    }
    
  }
  if(bme_humidVal > 49)    //과습일때 69 test 49
  {
    offFunct();
    digitalWrite(blue_pin,HIGH);
    
    flag2=1;
    if(!cf)
    {
      // Clear the buffer.
      display.clearDisplay();
  
      // Draw bitmap on the screen
      display.drawBitmap(0, 0, ToohumidImage, 128, 64, 1);
      display.display();
    }
  }
  if(bme_tempVal < 20)  //온도 낮을때 12 test 20
  {
    offFunct();
    digitalWrite(blue_pin,HIGH);

    
    flag3=1;

    if(!cf)
    {
      // Clear the buffer.
      display.clearDisplay();
  
      // Draw bitmap on the screen
      display.drawBitmap(0, 0, coldImage, 128, 64, 1);
      display.display();
    }
  }
  if(bme_tempVal > 25)   //온도 높을때 test 25
  {
    offFunct();
    digitalWrite(blue_pin,HIGH);
    
    flag4 = 1;
    if(!cf)
    {
      // Clear the buffer.
      display.clearDisplay();
  
      // Draw bitmap on the screen
      display.drawBitmap(0, 0, Hot_image, 128, 64, 1);
      display.display();
    }
  }
  
  //하나라도 T이면 나쁜 표정 아니라면 좋은 표정 하기 
  if(!flag1 && !flag2 && !flag3 && !flag4&&!cf)
  {
    offFunct();
    digitalWrite(green_pin,HIGH);
    
    // Clear the buffer.
    display.clearDisplay();
  
    // Draw bitmap on the screen
    display.drawBitmap(0, 0, Defalut_Image, 128, 64, 1);
    display.display();    
  }

  float dustVout = getAvgDustVal();
  while(dustVout>100000)
  {
    dustVout = getAvgDustVal();
  }
  


  sprintf(payload,"{\"state\":{\"reported\":{\"temp\":%f,\"humid\":%f,\"dust\":%f,\"flag1\":%d,\"flag2\":%d,\"flag3\":%d,\"flag4\":%d,\"flag5\":%d,\"count\":%d}}}",bme_tempVal,bme_humidVal,dustVout,flag1,flag2,flag3,flag4,flag5,countval);
  Serial.println("for debuger publish function terminated  ");
  
  
  while(testButton.publish(pTOPIC_NAME,payload)!=0)
  {
    
  }
  
  Serial.print("Publish Message:");
  Serial.println(payload);
  delay(500);
    
}
void check_live_curret(int m)
{
  if(led2=="currentdata")
  {
    Serial.println("main !!!!!!!!!!!!!current data receive!!!!!!!!!!!!!!!!! main ");
    flag5 = 0;
    //msgReceived2=m;
    led2="";
    return;
  }
  if(m == 1)  
  {

    m = 0;
    
    //Serial.print("MAIN !! Received Message:");
    //Serial.println(rcvdPayload);
    // Parse JSON
    JSONVar myObj = JSON.parse(rcvdPayload);
    JSONVar state = myObj["state"];
    JSONVar desired = state["desired"];
    led = (const char*)desired["ask"];
    Serial.print("livedata will be ");
    Serial.println(led);
    if(led=="currentdata")
    {
      return;
    }
    

  }
  while(led=="livedata")
  {
    flag5 = 1;
    //Serial.println("IN WHILE");
    //if(m == 1)  //msgReceive2 maybe you need the msgReceive2 flag ? maybe...  
    //{
      //m = 0;
    //Serial.print("main Received Message:");
    //Serial.println(rcvdPayload);
        // Parse JSON
    JSONVar myObj = JSON.parse(rcvdPayload);
    JSONVar state = myObj["state"];
    JSONVar desired = state["desired"];
    led2 = (const char*)desired["ask"];
    Serial.print("main livedata will be ");
    Serial.println(led2);
      
      
    //}
    if(led2=="currentdata")
    {
      //Serial.println("main !!!!!!!!!!!!!current data receive!!!!!!!!!!!!!!!!! main ");
      flag5 = 0;
      led2="";
      //msgReceived2=m;
      return;
    }
    
    publishData(-1);
    //led="livedata";
    delay(3000);
    
    
  }  
}
void setup() 
{
  bool status;
  
  // put your setup code here, to run once:
  Serial.begin(115200);
  //++choi This is here to force the ESP32 to reset the WiFi and initialize correctly.
  Serial.print("WIFI status = ");
  Serial.println(WiFi.getMode());
  WiFi.disconnect(true);
  delay(1000);
  WiFi.mode(WIFI_STA);
  delay(1000);
  Serial.print("WIFI status = ");
  Serial.println(WiFi.getMode()); //++choi
  WiFi.begin(ssid, password);
  while (WiFi.status() != WL_CONNECTED) 
  {
    delay(1000);
    Serial.println("Connecting to WiFi..");
  }
  Serial.println("Connected to wifi");
  if(testButton.connect(HOST_ADDRESS,CLIENT_ID)== 0) 
  {
    Serial.println("Connected to AWS");
    delay(1000);
    
    if(0==testButton.subscribe(sTOPIC_NAME,mySubCallBackHandler)) 
    {
      Serial.println("Subscribe Successfull");
      
    }
    else 
    {
      Serial.println("Subscribe Failed, Check the Thing Name and Certificates");
      while(1);
    }


  }
  else 
  {
    Serial.println("AWS connection failed, Check the HOST Address");
    while(1);
  }
  // initialize the pushbutton pin as an input

//*-----------------------------------------------------------------------*

//set the dust pin and pump pin set up 


pinMode(iredPin,OUTPUT);
pinMode(pump_AA,OUTPUT);
pinMode(pump_AB,OUTPUT);



//*---------------------------------------------------------------------*
//set the 3 rgb gpio pinmode

pinMode(red_pin,OUTPUT);
pinMode(blue_pin,OUTPUT);
pinMode(green_pin,OUTPUT);

//*---------------------------------------------------------------------*
//set the OLED pinmap and OLED set
  display.begin(0, true); 

  display.display();
  delay(1000);
  display.clearDisplay();
  
  // Draw bitmap on the screen
  display.drawBitmap(0, 0, Defalut_Image, 128, 64, 1);
  display.display();
  delay(1000);  
//*---------------------------------------------------------------------*

  Serial.println(F("BME280 test"));
  pinMode(Bme_Power,OUTPUT);    //use gpio as power source
  
  status = bme.begin(0x76);

/*

*/


  delay(2000);
  //who am i 가 아니라면
  while(!bme.begin(0x76)) 
  {
    
    Serial.println("Could not find a valid BME280 sensor, check wiring, address, sensor ID!");
    Serial.print("SensorID was: 0x"); 
    Serial.println(bme.sensorID(),16);
    Serial.print(" ID of 0xFF probably means a bad address, a BMP 180 or BMP 085\n");
    Serial.print(" ID of 0x56-0x58 represents a BMP 280,\n");
    Serial.print(" ID of 0x60 represents a BME 280.\n");
    Serial.print(" ID of 0x61 represents a BME 680.\n");

    Serial.println("BME280 will be reset by SW");
    digitalWrite(Bme_Power,LOW);
    delay(50);
    digitalWrite(Bme_Power,HIGH);
    delay(100);
  }
  bmeID = bme.sensorID();
  Serial.println("-- Default Test --");
  delayTime = 1000;
  Serial.println();
  delay(1000);
}

void loop() 
{

  //현재 데이터 보내라고 할때 처리 하기 
  check_live_curret(msgReceived);
  led="";
  led2="";
 /* 
  if(msgReceived == 1)  //msgReceive2 maybe you need the msgReceive2 flag ? maybe...  
  {
    msgReceived = 0;
    
    Serial.print("MAIN !! Received Message:");
    Serial.println(rcvdPayload);
    // Parse JSON
    JSONVar myObj = JSON.parse(rcvdPayload);
    JSONVar state = myObj["state"];
    JSONVar desired = state["desired"];
    led = (const char*) desired["ask"];
    Serial.print("livedata will be ");
    Serial.println(led);
    

  }
  while(led=="livedata")
  {
    flag5 = 1;
    Serial.println("IN WHILE");
    if(msgReceived == 1)  //msgReceive2 maybe you need the msgReceive2 flag ? maybe...  
    {
      msgReceived = 0;
      Serial.print("main Received Message:");
      Serial.println(rcvdPayload);
      // Parse JSON
      JSONVar myObj = JSON.parse(rcvdPayload);
      JSONVar state = myObj["state"];
      JSONVar desired = state["desired"];
      led2 = (const char*) desired["ask"];
      Serial.print("main livedata will be ");
      Serial.println(led2);
      
      
    }
    if(led2=="currentdata")
    {
      Serial.println("main !!!!!!!!!!!!!current data receive!!!!!!!!!!!!!!!!! main ");
      flag5 = 0;
      break;
    }
    
    publishData(-1);
    led="livedata";
    delay(2000);
    
    
  }*/

//위의 꺼 led3,4따로 만들어서 처리 해야할듯 const char 바꿀수 없다고 
  
/*
현재 값 요청 들어오면 shadow에서 flag값 받아서 현재 값 보내주기 


*/
  /////////토양센서값은 계속 확인하기 /////////////////////
  //계속 토양 평균값 내는것이 맞을까? -> scaling때문에 애만 예외적으로 하자  
  int soil_moisture = readSoilMoister();    //avg soil moisture 

  delay(200);
  
  //토양센서에서 수분이 부족할때 물 주는 작업 && 물펌프 없을때 데이터 보내기 처리 
  if(soil_moisture < 20)
  {
    
    Serial.println("DRY!");
    

    //3초동안 pump start 
    digitalWrite(pump_AA,HIGH);
    digitalWrite(pump_AB,LOW);
    delay(3000);
    digitalWrite(pump_AA,LOW);
    digitalWrite(pump_AB,LOW);    

    delay(3000);  //3초동안 물 충분히 들어가는 시간 줌 **시간 조정 해야할수도있다**
     
    int temp_soil_val = readSoilMoister();
    
    //물 없다는 의미, 처리 해야함 
    if(temp_soil_val <= soil_moisture || temp_soil_val < 20)
    {
      //인자로 soil_moistuer넘기기
      check_soil_funct(soil_moisture);
      cf=0;
      
    }
  }

  

  /////////////////////////////////////////////////////
  
  //set the Timer 1hour 
  if((millis()-preMil) >= intMil) 
  {
    preMil = millis();

    //check the bme280 reset 

    if(bme.sensorID()!=bmeID)
    {
      Serial.println("BME280 will be reset by SW");
      digitalWrite(Bme_Power,LOW);
      delay(50);
      digitalWrite(Bme_Power,HIGH);
      delay(100);
    }

    //count 값 의미없다고 하면 -1의 값 변화가 있다면 count값 적용해야한다
    publishData(-1);

    
  }
  
}
